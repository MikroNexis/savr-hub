## build_AdafruitFeather/Kconfig/boards/Kconfig.sysbuild
```kconfig
# Load Sysbuild board Kconfig descriptions.
osource "D:/ncs/v3.4.1/zephyr/boards/adafruit/feather_nrf52840/Kconfig.sysbuild"
```

## build_AdafruitFeather/savr-hub/Kconfig/boards/Kconfig.adafruit_feather_nrf52840.tmp
```kconfig
# Load board Kconfig descriptions.
osource "D:/ncs/v3.4.1/zephyr/boards/adafruit/feather_nrf52840/Kconfig.adafruit_feather_nrf52840"
```

## build_AdafruitFeather/savr-hub/Kconfig/boards/Kconfig.defconfig
```kconfig
# Load Zephyr board defconfig descriptions.
osource "D:/ncs/v3.4.1/zephyr/boards/adafruit/feather_nrf52840/Kconfig.defconfig"
```

## build_nRF52840DK/Kconfig/boards/Kconfig.defconfig.tmp
```kconfig
# Load Zephyr board defconfig descriptions.
osource "D:/ncs/v3.4.1/zephyr/boards/nordic/nrf52840dk/Kconfig.defconfig"
```

## build_nRF52840DK/savr-hub/Kconfig/boards/Kconfig.sysbuild.tmp
```kconfig
# Load Sysbuild board Kconfig descriptions.
osource "D:/ncs/v3.4.1/zephyr/boards/nordic/nrf52840dk/Kconfig.sysbuild"
```
